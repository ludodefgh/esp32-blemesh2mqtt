## main/Kconfig.projbuild
```kconfig
menu "Example Configuration"

    config BROKER_URL
        string "Broker URL"
        default "mqtt://mqtt.eclipseprojects.io"
        help
            URL of the broker to connect to

    config BROKER_URL_FROM_STDIN
        bool
        default y if BROKER_URL = "FROM_STDIN"

    config ESP_WIFI_SSID
        string "WiFi SSID"
        default "myssid"
        help
            SSID (network name) for the example to connect to.

    config ESP_WIFI_PASSWORD
        string "WiFi Password"
        default "mypassword"
        help
            WiFi password (WPA or WPA2) for the example to use.

    choice ESP_WIFI_SAE_MODE
        prompt "WPA3 SAE mode selection"
        default ESP_STATION_EXAMPLE_WPA3_SAE_PWE_BOTH
        help
            Select mode for SAE as Hunt and Peck, H2E or both.
        config ESP_STATION_EXAMPLE_WPA3_SAE_PWE_HUNT_AND_PECK
            bool "HUNT AND PECK"
        config ESP_STATION_EXAMPLE_WPA3_SAE_PWE_HASH_TO_ELEMENT
            bool "H2E"
            depends on ESP_WIFI_ENABLE_SAE_H2E
        config ESP_STATION_EXAMPLE_WPA3_SAE_PWE_BOTH
            bool "BOTH"
            depends on ESP_WIFI_ENABLE_SAE_H2E
    endchoice

    config ESP_WIFI_PW_ID
        string "PASSWORD IDENTIFIER"
        depends on  ESP_STATION_EXAMPLE_WPA3_SAE_PWE_HASH_TO_ELEMENT|| ESP_STATION_EXAMPLE_WPA3_SAE_PWE_BOTH
        default ""
        help
            password identifier for SAE H2E

    config ESP_MAXIMUM_RETRY
        int "Maximum retry"
        default 5
        help
            Set the Maximum retry to avoid station reconnecting to the AP unlimited when the AP is really inexistent.

    menu "WiFi Reconnection Settings"
        
        config WIFI_RECONNECT_UNLIMITED_ATTEMPTS
            bool "Enable unlimited reconnection attempts"
            default n
            help
                When enabled, the device will continuously attempt to reconnect to WiFi
                without giving up after a maximum number of attempts.
        
        config WIFI_RECONNECT_MAX_ATTEMPTS
            int "Maximum reconnection attempts"
            depends on !WIFI_RECONNECT_UNLIMITED_ATTEMPTS
            default 5
            range 1 50
            help
                Maximum number of consecutive reconnection attempts before giving up.
                Only used when unlimited attempts is disabled.
        
        config WIFI_RECONNECT_DELAY_MS
            int "Reconnection delay (milliseconds)"
            default 20000
            range 1000 300000
            help
                Delay between reconnection attempts when unlimited attempts is enabled,
                or maximum delay for exponential backoff when limited attempts is used.
        
        config WIFI_RECONNECT_INITIAL_DELAY_MS
            int "Initial reconnection delay (milliseconds)"
            depends on !WIFI_RECONNECT_UNLIMITED_ATTEMPTS
            default 1000
            range 100 60000
            help
                Initial delay for the first reconnection attempt when using exponential backoff.
                Subsequent attempts will double the delay up to the maximum delay.

    endmenu

    choice ESP_WIFI_SCAN_AUTH_MODE_THRESHOLD
        prompt "WiFi Scan auth mode threshold"
        default ESP_WIFI_AUTH_WPA2_PSK
        help
            The weakest authmode to accept in the scan mode.
            This value defaults to ESP_WIFI_AUTH_WPA2_PSK in case password is present and ESP_WIFI_AUTH_OPEN is used.
            Please select ESP_WIFI_AUTH_WEP/ESP_WIFI_AUTH_WPA_PSK in case AP is operating in WEP/WPA mode.

        config ESP_WIFI_AUTH_OPEN
            bool "OPEN"
        config ESP_WIFI_AUTH_WEP
            bool "WEP"
        config ESP_WIFI_AUTH_WPA_PSK
            bool "WPA PSK"
        config ESP_WIFI_AUTH_WPA2_PSK
            bool "WPA2 PSK"
        config ESP_WIFI_AUTH_WPA_WPA2_PSK
            bool "WPA/WPA2 PSK"
        config ESP_WIFI_AUTH_WPA3_PSK
            bool "WPA3 PSK"
        config ESP_WIFI_AUTH_WPA2_WPA3_PSK
            bool "WPA2/WPA3 PSK"
        config ESP_WIFI_AUTH_WAPI_PSK
            bool "WAPI PSK"
    endchoice

endmenu
```

## sdkconfig.defaults
```kconfig
# Common configuration for all ESP32 targets
# BleMesh2MQTT Bridge - Base settings shared across all targets
# This file is applied first, then target-specific sdkconfig.defaults.{TARGET} files
#
# THIS FILE CONTAINS ALL OPTIMIZATIONS AND SETTINGS FROM GIT HISTORY
# Diff between first commit (157176e) and last commit (bb9be86)

#
# Compiler Optimizations (Size)
#
CONFIG_COMPILER_OPTIMIZATION_SIZE=y
CONFIG_COMPILER_OPTIMIZATION_ASSERTIONS_DISABLE=y
CONFIG_COMPILER_OPTIMIZATION_ASSERTION_LEVEL=0
CONFIG_COMPILER_OPTIMIZATION_LEVEL_RELEASE=y
# CONFIG_COMPILER_CXX_EXCEPTIONS is not set
CONFIG_BOOTLOADER_COMPILER_OPTIMIZATION_SIZE=y

# Legacy optimization names (backward compatibility)
CONFIG_OPTIMIZATION_LEVEL_RELEASE=y
CONFIG_OPTIMIZATION_ASSERTION_LEVEL=0
CONFIG_OPTIMIZATION_ASSERTIONS_DISABLED=y

#
# HAL Assertions (DISABLED for size)
#
CONFIG_HAL_DEFAULT_ASSERTION_LEVEL=0

#
# Bluetooth Stack Selection (CRITICAL)
#
CONFIG_BT_ENABLED=y
CONFIG_BT_BLUEDROID_ENABLED=y
# CONFIG_BT_NIMBLE_ENABLED is not set
CONFIG_BT_BLUEDROID_PINNED_TO_CORE_0=y
CONFIG_BT_BLUEDROID_PINNED_TO_CORE=0
CONFIG_BT_BLUEDROID_ESP_COEX_VSC=y

# Bluetooth Classic DISABLED (BLE only - saves significant space)
# CONFIG_BT_CLASSIC_ENABLED is not set

#
# BLE Configuration
#
CONFIG_BT_BLE_ENABLED=y
# CONFIG_BT_BLE_BLUFI_ENABLE is not set
CONFIG_BT_BLE_SMP_ENABLE=y
CONFIG_BT_BLE_SMP_BOND_NVS_FLASH=y
CONFIG_BT_BLE_42_FEATURES_SUPPORTED=y
CONFIG_BT_BTC_TASK_STACK_SIZE=3072
CONFIG_BT_BTU_TASK_STACK_SIZE=4512

# BLE Connection Timeouts (Reduced for faster connection)
CONFIG_BT_BLE_ESTAB_LINK_CONN_TOUT=30
CONFIG_BLE_ESTABLISH_LINK_CONNECTION_TIMEOUT=30

# BLE HCI Debug (DISABLED for size)
# CONFIG_BT_HCI_LOG_DEBUG_EN is not set

#
# BLE Mesh Core Configuration
#
CONFIG_BLE_MESH=y
CONFIG_BLE_MESH_HCI_5_0=y
CONFIG_BLE_MESH_V11_SUPPORT=y
CONFIG_BLE_MESH_USE_DUPLICATE_SCAN=y
CONFIG_BLE_MESH_MEM_ALLOC_MODE_INTERNAL=y
CONFIG_BLE_MESH_DEINIT=y

#
# BLE Mesh Mode (Provisioner only, NOT node)
#
# CONFIG_BLE_MESH_NODE is not set

#
# BLE Mesh Provisioner
#
CONFIG_BLE_MESH_PROVISIONER=y
CONFIG_BLE_MESH_MAX_PROV_NODES=25
CONFIG_BLE_MESH_WAIT_FOR_PROV_MAX_DEV_NUM=10
CONFIG_BLE_MESH_PBA_SAME_TIME=2
CONFIG_BLE_MESH_PBG_SAME_TIME=1
CONFIG_BLE_MESH_PROVISIONER_SUBNET_COUNT=3
CONFIG_BLE_MESH_PROVISIONER_APP_KEY_COUNT=3

#
# BLE Mesh Features
#
CONFIG_BLE_MESH_PROV=y
CONFIG_BLE_MESH_PROV_EPA=y
CONFIG_BLE_MESH_PB_ADV=y
CONFIG_BLE_MESH_PB_GATT=y
CONFIG_BLE_MESH_PROXY=y
CONFIG_BLE_MESH_NET_BUF_POOL_USAGE=y
CONFIG_BLE_MESH_CFG_CLI=y

#
# BLE Mesh Storage
#
CONFIG_BLE_MESH_SETTINGS=y
CONFIG_BLE_MESH_STORE_TIMEOUT=0
CONFIG_BLE_MESH_SEQ_STORE_RATE=0
CONFIG_BLE_MESH_RPL_STORE_TIMEOUT=0

#
# BLE Mesh Network Configuration
#
CONFIG_BLE_MESH_SUBNET_COUNT=3
CONFIG_BLE_MESH_APP_KEY_COUNT=3
CONFIG_BLE_MESH_MODEL_KEY_COUNT=3
CONFIG_BLE_MESH_MODEL_GROUP_COUNT=3
CONFIG_BLE_MESH_LABEL_COUNT=3
CONFIG_BLE_MESH_CRPL=10
CONFIG_BLE_MESH_MSG_CACHE_SIZE=10
CONFIG_BLE_MESH_ADV_BUF_COUNT=60
CONFIG_BLE_MESH_IVU_DIVIDER=4
CONFIG_BLE_MESH_TX_SEG_MSG_COUNT=10
CONFIG_BLE_MESH_RX_SEG_MSG_COUNT=10
CONFIG_BLE_MESH_RX_SDU_MAX=384
CONFIG_BLE_MESH_TX_SEG_MAX=32

#
# BLE Mesh Client Models (CRITICAL - Required for light control!)
#
CONFIG_BLE_MESH_GENERIC_ONOFF_CLI=y
CONFIG_BLE_MESH_GENERIC_LEVEL_CLI=y
CONFIG_BLE_MESH_LIGHT_LIGHTNESS_CLI=y
CONFIG_BLE_MESH_LIGHT_CTL_CLI=y
CONFIG_BLE_MESH_LIGHT_HSL_CLI=y
CONFIG_BLE_MESH_LIGHT_LC_CLI=y

#
# BLE Mesh Server Models (DISABLED for size)
#
# CONFIG_BLE_MESH_GATT_PROXY_CLIENT is not set
# CONFIG_BLE_MESH_GENERIC_SERVER is not set
# CONFIG_BLE_MESH_SENSOR_SERVER is not set
# CONFIG_BLE_MESH_TIME_SCENE_SERVER is not set
# CONFIG_BLE_MESH_LIGHTING_SERVER is not set
# CONFIG_BLE_MESH_SRPL_CLI is not set

#
# BLE Mesh Debug (DISABLED for size)
#
# CONFIG_BLE_MESH_DEBUG is not set
# CONFIG_BLE_MESH_TRACE_LEVEL_DEBUG is not set
# CONFIG_BLE_MESH_NET_BUF_TRACE_LEVEL_DEBUG is not set

#
# BLE Mesh Tracing
#
CONFIG_BLE_MESH_TRACE_LEVEL_WARNING=y
CONFIG_BLE_MESH_STACK_TRACE_LEVEL=2
CONFIG_BLE_MESH_NET_BUF_TRACE_LEVEL_WARNING=y
CONFIG_BLE_MESH_NET_BUF_TRACE_LEVEL=2
CONFIG_BLE_MESH_CLIENT_MSG_TIMEOUT=8000

#
# WiFi Configuration
#
CONFIG_ESP_WIFI_STATIC_RX_BUFFER_NUM=10
CONFIG_ESP_WIFI_DYNAMIC_RX_BUFFER_NUM=32
CONFIG_ESP_WIFI_DYNAMIC_TX_BUFFER_NUM=32

# WiFi Provisioning & Reconnection (Custom logic)
CONFIG_WIFI_RECONNECT_UNLIMITED_ATTEMPTS=y
CONFIG_WIFI_RECONNECT_DELAY_MS=10000

# WiFi Advanced Features DISABLED (size optimization)
# CONFIG_WPA_11KV_SUPPORT is not set
# CONFIG_WPA_MBO_SUPPORT is not set
# CONFIG_WPA_DPP_SUPPORT is not set
# CONFIG_WPA_11R_SUPPORT is not set

# WiFi Examples Config (defaults for menuconfig)
CONFIG_ESP_WIFI_SSID="myssid"
CONFIG_ESP_WIFI_PASSWORD="mypassword"
CONFIG_ESP_WIFI_PW_ID=""
CONFIG_ESP_MAXIMUM_RETRY=5
CONFIG_ESP_WIFI_AUTH_WPA2_PSK=y
CONFIG_ESP_STATION_EXAMPLE_WPA3_SAE_PWE_BOTH=y

#
# LWIP Configuration (CORRECTED VALUES)
#
CONFIG_LWIP_MAX_SOCKETS=8
CONFIG_LWIP_SO_REUSE=y
CONFIG_LWIP_SO_REUSE_RXTOALL=y
CONFIG_LWIP_TCPIP_TASK_PRIO=18
CONFIG_LWIP_DNS_SUPPORT_MDNS_QUERIES=y
CONFIG_LWIP_TIMERS_ONDEMAND=y
CONFIG_LWIP_DHCP_DOES_ARP_CHECK=y
CONFIG_LWIP_DHCPS=y
CONFIG_LWIP_DHCPS_LEASE_UNIT=60
CONFIG_LWIP_DHCPS_MAX_STATION_NUM=8
CONFIG_LWIP_DHCPS_STATIC_ENTRIES=y
CONFIG_LWIP_DHCPS_ADD_DNS=y
CONFIG_LWIP_MAX_ACTIVE_TCP=16
CONFIG_LWIP_MAX_LISTENING_TCP=16
CONFIG_LWIP_TCP_MAXRTX=12
CONFIG_LWIP_TCP_SYNMAXRTX=12
CONFIG_LWIP_TCPIP_TASK_STACK_SIZE=3072
CONFIG_LWIP_DHCP_OPTIONS_LEN=69

# IPv6 DISABLED (size optimization)
# CONFIG_LWIP_IPV6 is not set

#
# HTTP Server Configuration
#
CONFIG_HTTPD_MAX_REQ_HDR_LEN=1024
CONFIG_HTTPD_MAX_URI_LEN=512
CONFIG_HTTPD_ERR_RESP_NO_DELAY=y
CONFIG_HTTPD_PURGE_BUF_LEN=32
CONFIG_HTTPD_WS_SUPPORT=y
CONFIG_HTTPD_SERVER_EVENT_POST_TIMEOUT=2000

#
# MQTT Configuration (CORRECTED - SSL/WebSocket ENABLED)
#
CONFIG_MQTT_PROTOCOL_311=y
CONFIG_MQTT_PROTOCOL_5=y
CONFIG_MQTT_TRANSPORT_SSL=y
CONFIG_MQTT_TRANSPORT_WEBSOCKET=y
CONFIG_MQTT_TRANSPORT_WEBSOCKET_SECURE=y
CONFIG_BROKER_URL="mqtt://mqtt.eclipseprojects.io"

#
# WebSocket Transport
#
CONFIG_WS_TRANSPORT=y
CONFIG_WS_BUFFER_SIZE=1024

#
# LittleFS Configuration
#
CONFIG_LITTLEFS_MAX_PARTITIONS=3
CONFIG_LITTLEFS_PAGE_SIZE=256
CONFIG_LITTLEFS_OBJ_NAME_LEN=64
CONFIG_LITTLEFS_READ_SIZE=128
CONFIG_LITTLEFS_WRITE_SIZE=128
CONFIG_LITTLEFS_LOOKAHEAD_SIZE=128
CONFIG_LITTLEFS_CACHE_SIZE=512
CONFIG_LITTLEFS_BLOCK_CYCLES=512
CONFIG_LITTLEFS_USE_MTIME=y
CONFIG_LITTLEFS_MTIME_USE_SECONDS=y
CONFIG_LITTLEFS_ASSERTS=y
CONFIG_LITTLEFS_MALLOC_STRATEGY_DEFAULT=y

#
# mbedTLS (SSL/TLS)
#
CONFIG_MBEDTLS_INTERNAL_MEM_ALLOC=y
CONFIG_MBEDTLS_ASYMMETRIC_CONTENT_LEN=y
CONFIG_MBEDTLS_SSL_IN_CONTENT_LEN=16384
CONFIG_MBEDTLS_SSL_OUT_CONTENT_LEN=4096
CONFIG_MBEDTLS_SSL_KEEP_PEER_CERTIFICATE=y
CONFIG_MBEDTLS_PKCS7_C=y
CONFIG_MBEDTLS_CERTIFICATE_BUNDLE=y
CONFIG_MBEDTLS_CERTIFICATE_BUNDLE_DEFAULT_FULL=y
# CONFIG_MBEDTLS_SSL_PROTO_TLS1_3 is not set

#
# Partition Table (Dual OTA for Xtensa targets: ESP32, ESP32-S3)
#
CONFIG_PARTITION_TABLE_CUSTOM=y
CONFIG_PARTITION_TABLE_CUSTOM_FILENAME="partitions/dual-ota.csv"
CONFIG_PARTITION_TABLE_FILENAME="partitions/dual-ota.csv"

#
# FreeRTOS Configuration (CORRECTED VALUES)
#
CONFIG_FREERTOS_HZ=100
CONFIG_FREERTOS_IDLE_TASK_STACKSIZE=1536
CONFIG_FREERTOS_ISR_STACKSIZE=1536
CONFIG_FREERTOS_TIMER_TASK_PRIORITY=1
CONFIG_FREERTOS_TIMER_TASK_STACK_DEPTH=4096
CONFIG_FREERTOS_CHECK_STACKOVERFLOW_CANARY=y
CONFIG_FREERTOS_SUPPORT_STATIC_ALLOCATION=y

#
# ESP System Configuration
#
CONFIG_ESP_SYSTEM_EVENT_TASK_STACK_SIZE=2304
CONFIG_ESP_MAIN_TASK_STACK_SIZE=3584
CONFIG_ESP_MAIN_TASK_AFFINITY_CPU0=y
CONFIG_ESP_MAIN_TASK_AFFINITY=0x0
CONFIG_ESP_IPC_TASK_STACK_SIZE=1024
CONFIG_ESP_TIMER_TASK_STACK_SIZE=3584

#
# ESP-TLS
#
CONFIG_ESP_TLS_USING_MBEDTLS=y

#
# Watchdog (CORRECTED TIMEOUT)
#
CONFIG_ESP_TASK_WDT_EN=y
CONFIG_ESP_TASK_WDT_INIT=y
CONFIG_ESP_TASK_WDT_TIMEOUT_S=5
CONFIG_ESP_TASK_WDT_CHECK_IDLE_TASK_CPU0=y
CONFIG_ESP_TASK_WDT_CHECK_IDLE_TASK_CPU1=y

#
# Log Configuration (Size Optimization)
#
CONFIG_LOG_DEFAULT_LEVEL_INFO=y
# CONFIG_LOG_MAXIMUM_LEVEL_VERBOSE is not set
CONFIG_LOG_MAXIMUM_LEVEL=3
# CONFIG_LOG_COLORS is not set
CONFIG_BOOTLOADER_LOG_LEVEL_INFO=y
CONFIG_BOOTLOADER_LOG_LEVEL=3
# CONFIG_BOOTLOADER_LOG_COLORS is not set

#
# Serial Flasher Config
#
CONFIG_ESPTOOLPY_FLASHMODE_DIO=y
# Flash frequency is target-specific (see sdkconfig.defaults.{target})
CONFIG_ESPTOOLPY_FLASHSIZE_4MB=y
CONFIG_ESPTOOLPY_FLASHSIZE="4MB"

#
# Security (Disabled)
#
CONFIG_SECURE_BOOT=n
CONFIG_SECURE_FLASH_ENC_ENABLED=n

#
# Power Management (DISABLED for size)
#
# CONFIG_PM_ENABLE is not set

#
# Newlib (Use nano format for smaller binary - compact printf/scanf)
#
# CONFIG_NEWLIB_NANO_FORMAT is not set

#
# SNTP
#
# CONFIG_LWIP_SNTP_STARTUP_DELAY is not set

#
```

## sdkconfig.defaults.esp32
```kconfig
# ESP32-specific configuration overrides
# Applied after sdkconfig.defaults when building for ESP32

# ESP32 has more resources - can support more connections
CONFIG_BT_NIMBLE_MAX_CONNECTIONS=7

# ESP32-specific optimizations
CONFIG_ESP32_DEFAULT_CPU_FREQ_240=y

# ESP32 Memory Optimization (Use SRAM1 as IRAM) - Xtensa only
CONFIG_ESP_SYSTEM_ESP32_SRAM1_REGION_AS_IRAM=y

# MODEM SLEEP Options (Bluedroid/ESP32 specific)
# CONFIG_BTDM_CTRL_MODEM_SLEEP is not set

# Flash frequency - 40MHz
CONFIG_ESPTOOLPY_FLASHFREQ_40M=y
```

## sdkconfig.defaults.esp32c3
```kconfig
# ESP32-C3-specific configuration overrides
# Applied after sdkconfig.defaults when building for ESP32-C3

# ESP32-C3 has less resources - limit connections
CONFIG_BT_NIMBLE_MAX_CONNECTIONS=4

# RISC-V specific - 160MHz CPU frequency
CONFIG_ESP_DEFAULT_CPU_FREQ_MHZ_160=y

# Flash frequency - 40MHz
CONFIG_ESPTOOLPY_FLASHFREQ_40M=y

# Partition table - Single OTA (no rollback) for larger RISC-V binaries
CONFIG_PARTITION_TABLE_CUSTOM_FILENAME="partitions/single-ota.csv"
```

## sdkconfig.defaults.esp32c5
```kconfig
# ESP32-C5-specific configuration overrides
# Applied after sdkconfig.defaults when building for ESP32-C5

# ESP32-C5 balanced resources
CONFIG_BT_NIMBLE_MAX_CONNECTIONS=5

# RISC-V specific - 240MHz CPU frequency (C5 supports higher than C3/C6)
CONFIG_ESP_DEFAULT_CPU_FREQ_MHZ_240=y

# Flash frequency - 40MHz
CONFIG_ESPTOOLPY_FLASHFREQ_40M=y

# Partition table - Single OTA (no rollback) for larger RISC-V binaries
CONFIG_PARTITION_TABLE_CUSTOM_FILENAME="partitions/single-ota.csv"
```

## sdkconfig.defaults.esp32c6
```kconfig
# ESP32-C6-specific configuration overrides
# Applied after sdkconfig.defaults when building for ESP32-C6

# ESP32-C6 balanced resources
CONFIG_BT_NIMBLE_MAX_CONNECTIONS=5

# RISC-V specific - 160MHz CPU frequency
CONFIG_ESP_DEFAULT_CPU_FREQ_MHZ_160=y

# Flash frequency - 40MHz
CONFIG_ESPTOOLPY_FLASHFREQ_40M=y

# Partition table - Single OTA (no rollback) for larger RISC-V binaries
CONFIG_PARTITION_TABLE_CUSTOM_FILENAME="partitions/single-ota.csv"
```

## sdkconfig.defaults.esp32s3
```kconfig
# ESP32-S3-specific configuration overrides
# Applied after sdkconfig.defaults when building for ESP32-S3

# ESP32-S3 has good resources - can support more connections
CONFIG_BT_NIMBLE_MAX_CONNECTIONS=8

# ESP32-S3 specific optimizations - 240MHz CPU
CONFIG_ESP_DEFAULT_CPU_FREQ_MHZ_240=y

# Flash frequency - 40MHz
CONFIG_ESPTOOLPY_FLASHFREQ_40M=y
```
